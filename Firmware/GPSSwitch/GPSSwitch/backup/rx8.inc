;;*****************************************************************************
;;*****************************************************************************
;;  FILENAME: RX8.inc
;;   Version: 3.50, Updated on 2015/3/4 at 22:26:55
;;  Generated by PSoC Designer 5.4.3191
;;
;;  DESCRIPTION: Assembler declarations for the RX8 user module interface.
;;-----------------------------------------------------------------------------
;;  Copyright (c) Cypress Semiconductor 2015. All Rights Reserved.
;;*****************************************************************************
;;*****************************************************************************

include "m8c.inc"

;--------------------------------------------------
; Constants for RX8 API's
;--------------------------------------------------

;mask value for global int reg bit for RX instance
RX8_bINT_MASK:        equ 80h
;RX8 interrupt address
RX8_INT_REG:          equ 0e1h

RX8_RXBUF_ENABLE:                           equ   0

RX8_RX_IGNORE_BELOW:                         equ  20h
RX8_RX_BUFFER_SIZE:                          equ  10h
RX8_CMD_TERM:                                equ  dh
RX8_DELIMITER:                               equ  20h

; This equate will be removed in future revisions.
; Do not use.
bRX8_INT_MASK:        equ 80h
;------------------------------------
;  RX8 Parity masks
;------------------------------------
RX8_PARITY_NONE:           equ   0h
RX8_PARITY_EVEN:           equ   2h
RX8_PARITY_ODD:            equ   6h

;------------------------------------
;  RX8 Status Register masks
;------------------------------------

RX8_RX_ACTIVE:             equ   10h
RX8_RX_COMPLETE:           equ   08h
RX8_RX_REG_FULL:           equ   08h
RX8_RX_PARITY_ERROR:       equ   80h
RX8_RX_OVERRUN_ERROR:      equ   40h
RX8_RX_FRAMING_ERROR:      equ   20h
RX8_RX_ERROR:              equ   E0h
RX8_RX_NO_ERROR:           equ   E0h   ; This symbol is deprecated and will removed in the future
RX8_RX_ENABLE:             equ   01h

RX8_RX_BUF_ERROR:                       equ   F0h  ; Mask for any Rx that may occur.
RX8_RX_BUF_OVERRUN:                     equ   10h  ; This indicates the software buffer has
                                                        ; been over run.
RX8_RX_BUF_CMDTERM:                     equ   01h  ; Command terminator has been received.

RX8_RX_NO_DATA:                         equ   01h
RX8_RX_NO_ERROR:                        equ   E0h

; Old equates, will be removed in future release
; Do not use
RX8_PARITY_NONE:           equ   0h
RX8_PARITY_EVEN:           equ   2h
RX8_PARITY_ODD:            equ   6h
RX8_RX_ACTIVE:             equ   10h
RX8_RX_COMPLETE:           equ   08h
RX8_RX_PARITY_ERROR:       equ   80h
RX8_RX_OVERRUN_ERROR:      equ   40h
RX8_RX_FRAMING_ERROR:      equ   20h
RX8_RX_NO_ERROR:           equ   E0h


;--------------------------------------------------
; Register Address Constants for RX8
;--------------------------------------------------
RX8_CONTROL_REG:    equ 3fh                      ;Control register
RX8_RX_SHIFT_REG:   equ 3ch                      ;RX Shift Register register
RX8_RX_BUFFER_REG:  equ 3eh                      ;RX Buffer Register
RX8_FUNC_REG:   equ 3ch                          ;Function register
RX8_INPUT_REG:  equ 3dh                          ;Input register
RX8_OUTPUT_REG: equ 3eh                          ;Output register

; end of file RX8.inc
