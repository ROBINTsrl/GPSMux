;;*****************************************************************************
;;*****************************************************************************
;;  FILENAME:   LED_FIX.inc
;;  Version: 2.00, Updated on 2015/3/4 at 22:26:37
;;  Generated by PSoC Designer 5.4.3191
;;
;;  DESCRIPTION:  Assembler declarations for the LED user module interface.
;;-----------------------------------------------------------------------------
;;  Copyright (c) Cypress Semiconductor 2015. All Rights Reserved.
;;*****************************************************************************
;;*****************************************************************************

include "m8c.inc"

LED_FIX_Port:      equ   0x0


LED_FIX_PortDR:    equ   PRT0DR

LED_FIX_PinMask:   equ  0x8

LED_FIX_Drive:     equ   0

LED_FIX_ON:        equ   1
LED_FIX_OFF:       equ   0

;------------------------------------------------------
;  Register Address Constants for  LED_FIX
;------------------------------------------------------

;------------------------------------------------------
;  Macros for  LED_FIX
;------------------------------------------------------





; end of file LED_FIX.inc
